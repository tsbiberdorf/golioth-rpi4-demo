## CMakeLists.txt
```
# SPDX-License-Identifier: Apache-2.0

cmake_minimum_required(VERSION 3.20.0)

find_package(Zephyr REQUIRED HINTS $ENV{ZEPHYR_BASE})
project(golioth_demo)

target_sources(app PRIVATE src/main.c)
```

## prj.conf
```kconfig
# General
CONFIG_HEAP_MEM_POOL_SIZE=8192
CONFIG_SYSTEM_WORKQUEUE_STACK_SIZE=4096

# Logging
CONFIG_LOG=y
CONFIG_LOG_BACKEND_UART=y

# Networking
CONFIG_NETWORKING=y
CONFIG_NET_IPV4=y
CONFIG_NET_IPV6=n
CONFIG_NET_TCP=y
CONFIG_NET_UDP=y
CONFIG_NET_SOCKETS=y

# DNS
CONFIG_DNS_RESOLVER=y

# Golioth SDK
CONFIG_GOLIOTH_FIRMWARE_SDK=y
CONFIG_GOLIOTH_SAMPLE_COMMON=y
CONFIG_GOLIOTH_SAMPLE_HARDCODED_CREDENTIALS=y

# CoAP
CONFIG_COAP=y
CONFIG_COAP_CLIENT=y

# TLS/DTLS
CONFIG_MBEDTLS=y
CONFIG_MBEDTLS_BUILTIN=y
CONFIG_MBEDTLS_ENABLE_HEAP=y
CONFIG_MBEDTLS_HEAP_SIZE=49152
CONFIG_MBEDTLS_SSL_MAX_CONTENT_LEN=2048

# Flash
CONFIG_FLASH=y
CONFIG_FLASH_MAP=y
CONFIG_NVS=y

# Shell
CONFIG_SHELL=y

# Static IP for native_sim
CONFIG_NET_CONFIG_SETTINGS=y
CONFIG_NET_CONFIG_MY_IPV4_ADDR="192.0.2.2"
CONFIG_NET_CONFIG_MY_IPV4_GW="192.0.2.1"
CONFIG_DNS_SERVER_IP_ADDRESSES=y
CONFIG_DNS_SERVER1="8.8.8.8"
```

## boards/native_sim.conf
```kconfig
# Use host networking (offloaded sockets)
CONFIG_NET_NATIVE=n
CONFIG_POSIX_API=y

# Slow down to real time
CONFIG_NATIVE_POSIX_SLOWDOWN_TO_REAL_TIME=y

# Shell
CONFIG_SHELL_BACKEND_SERIAL=y

# Entropy
CONFIG_ENTROPY_GENERATOR=y
CONFIG_TEST_RANDOM_GENERATOR=y
```

## src/main.c
```c
/*
 * Copyright (c) 2024 Golioth, Inc.
 * SPDX-License-Identifier: Apache-2.0
 */

#include <zephyr/kernel.h>
#include <zephyr/logging/log.h>
#include <golioth/client.h>
#include <samples/common/sample_credentials.h>

LOG_MODULE_REGISTER(golioth_demo, LOG_LEVEL_DBG);

static struct golioth_client *client;
K_SEM_DEFINE(connected_sem, 0, 1);

static void on_client_event(struct golioth_client *client,
                            enum golioth_client_event event,
                            void *arg)
{
    switch (event) {
    case GOLIOTH_CLIENT_EVENT_CONNECTED:
        LOG_INF("Golioth client connected!");
        k_sem_give(&connected_sem);
        break;
    case GOLIOTH_CLIENT_EVENT_DISCONNECTED:
        LOG_WRN("Golioth client disconnected");
        break;
    default:
        break;
    }
}

int main(void)
{
    int err;
    int counter = 0;

    LOG_INF("Golioth RPi4 Demo Starting");

    client = golioth_client_create(&(struct golioth_client_config){
        .credentials = {
            .auth_type = GOLIOTH_TLS_AUTH_TYPE_PSK,
            .psk = {
                .psk_id = CONFIG_GOLIOTH_SAMPLE_PSK_ID,
                .psk_id_len = sizeof(CONFIG_GOLIOTH_SAMPLE_PSK_ID) - 1,
                .psk = CONFIG_GOLIOTH_SAMPLE_PSK,
                .psk_len = sizeof(CONFIG_GOLIOTH_SAMPLE_PSK) - 1,
            },
        },
    });

    if (!client) {
        LOG_ERR("Failed to create Golioth client");
        return -1;
    }

    golioth_client_register_event_callback(client, on_client_event, NULL);

    err = golioth_client_start(client);
    if (err) {
        LOG_ERR("Failed to start Golioth client: %d", err);
        return err;
    }

    LOG_INF("Waiting for connection to Golioth...");
    k_sem_take(&connected_sem, K_FOREVER);

    while (true) {
        LOG_INF("Hello from RPi4! Counter: %d", counter);
        counter++;
        k_sleep(K_SECONDS(10));
    }

    return 0;
}
```
